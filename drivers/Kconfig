## drivers/Kconfig
```kconfig
# Copyright (c) 2021 Nordic Semiconductor ASA
# SPDX-License-Identifier: Apache-2.0

menu "Drivers"
rsource "cad_qspi/Kconfig"
rsource "analog_ad4002/Kconfig"
rsource "cad_pwm/Kconfig"
endmenu
```

## drivers/analog_ad4002/Kconfig
```kconfig
menuconfig AD4002
    bool "Analog AD4002 SPI Device Driver"
    depends on DT_HAS_ST_STM32_PWM_ENABLED
    select SPI
    select SPI_STM32 if DT_HAS_ST_STM32_SPI_ENABLED
    select PWM
	select USE_STM32_LL_TIM
	select USE_STM32_LL_RCC if SOC_SERIES_STM32F4X || SOC_SERIES_STM32F7X || SOC_SERIES_STM32H7X
	select RESET
    help
        Enable STM32 SPI, PWM, and DMA for AD4002

if AD4002

module = AD4002
module-str = AD4002
source "subsys/logging/Kconfig.template.log_config"

config AD4002_SPI_INIT_PRIORITY
    int "AD4002 SPI INITIALIZATION PRIORITY"
    default 90
    help
        AD4002 SPI peripheral initialization priority

endif


if PWM

module = PWM
module-str = pwm
source "subsys/logging/Kconfig.template.log_config"

config PWM_INIT_PRIORITY
	int "PWM initialization priority"
	default KERNEL_INIT_PRIORITY_DEVICE
	help
	  System initialization priority for PWM drivers.

endif
```

## drivers/cad_dma/Kconfig
```kconfig
menuconfig CAD_DMA_MINIMAL
    bool "Custom Minimal DMA Driver"
	select USE_STM32_LL_RCC if SOC_SERIES_STM32F4X || SOC_SERIES_STM32F7X || SOC_SERIES_STM32H7X
	select RESET
    help
        This option enables a minimal version of the DMA driver so that most functions (including interrupts) can be handled manually by other drivers.

if CAD_DMA_MINIMAL

module = CAD_DMA_MINIMAL
module-str = CAD_DMA_MINIMAL
source "subsys/logging/Kconfig.template.log_config"

config DMA_INIT_PRIORITY
    int "DMA INITIALIZATION PRIORITY"
    default KERNEL_INIT_PRIORITY_DEFAULT
    help
        STM32 DMA peripheral initialization priority

endif
```

## drivers/cad_pwm/Kconfig
```kconfig
menuconfig FAST_PWM
    bool "Fast PWM Device Driver"
    depends on DT_HAS_ST_STM32_PWM_ENABLED
	select USE_STM32_LL_TIM
	select USE_STM32_LL_RCC if SOC_SERIES_STM32F4X || SOC_SERIES_STM32F7X || SOC_SERIES_STM32H7X
	select RESET
    help
        This option enables a faster version of the PWM driver for STM32 family of processors. 

if FAST_PWM

module = FAST_PWM
module-str = FAST_PWM
source "subsys/logging/Kconfig.template.log_config"

endif
```

## drivers/cad_qspi/Kconfig
```kconfig
DT_STM32_QUADSPI_HAS_DMA := $(dt_nodelabel_has_prop,quadspi,dmas)

menuconfig CAD_STM32_QSPI
    bool "Custom STM32_QSPI Driver"
    select USE_STM32_HAL_QSPI
    select DMA if $(DT_STM32_QUADSPI_HAS_DMA)
    select USE_STM32_HAL_DMA if $(DT_STM32_QUADSPI_HAS_DMA)
    help
        Enable QSPI General Read Interface on STM32 Processors


if CAD_STM32_QSPI

module = CAD_STM32_QSPI
module-str = CAD_STM32_QSPI
source "subsys/logging/Kconfig.template.log_config"

config QSPI_INIT_PRIORITY
    int "QSPI init priority"
    default 90
    help
        Quadspi peripheral initialization priority

endif
```

## dts/bindings/analog/analog_ad4002.yaml
```yaml
description: |

  Analog Devices AD4002 ADC, SPI binding

  Driver bindings for controlling an AD4002 or compatible ADC with a SPI master.

  The SPI driver should be usable as long as a zephyr SPI API driver
  is available for your board. 
  
compatible: "analog,ad4002"

include: [spi-device.yaml, base.yaml]

properties:
  default_property:
    type: boolean
```

## dts/bindings/ccDrive.yaml
```yaml
description: PWM-driven clotchip driver
compatible: "ccDrive"

include: base.yaml

properties:
  pwms:
    required: true
    type: phandle-array
    description: PWM specifier driving the clotchip
```
